## example18_centralized_deferred_interrupt/sdkconfig.defaults
```kconfig
CONFIG_IDF_TARGET="esp32c3"
CONFIG_FREERTOS_UNICORE=y
CONFIG_ESP_TIMER_SUPPORTS_ISR_DISPATCH_METHOD=y
CONFIG_FREERTOS_TIMER_TASK_PRIORITY=5
CONFIG_FREERTOS_TIMER_QUEUE_LENGTH=10
```

## example7_idle_hook/sdkconfig.defaults
```kconfig
CONFIG_IDF_TARGET="esp32c3"
CONFIG_FREERTOS_UNICORE=y
CONFIG_FREERTOS_LEGACY_HOOKS=y
CONFIG_FREERTOS_LEGACY_IDLE_HOOK=y
```
